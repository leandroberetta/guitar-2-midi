#include "oled.h"
#include "midi.h"
#include <string.h>
#include <stdio.h>

static I2C_HandleTypeDef *oled_i2c;

#define OLED_COMMAND 0x00
#define OLED_DATA    0x40

static volatile uint8_t oled_tx_done = 1;

const uint8_t font5x8[][5] = { { 0x00, 0x00, 0x00, 0x00, 0x00 }, { 0x00, 0x00,
		0x5F, 0x00, 0x00 }, { 0x00, 0x07, 0x00, 0x07, 0x00 }, { 0x14, 0x7F,
		0x14, 0x7F, 0x14 }, { 0x24, 0x2A, 0x7F, 0x2A, 0x12 }, { 0x23, 0x13,
		0x08, 0x64, 0x62 }, { 0x36, 0x49, 0x55, 0x22, 0x50 }, { 0x00, 0x05,
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		0x50, 0x50, 0x3C }, { 0x44, 0x64, 0x54, 0x4C, 0x44 } };

static const uint8_t* get_char_bitmap(char c) {
	if (c < 32 || c > 127)
		c = '?';
	return font5x8[c - 32];
}

static void OLED_WriteCommand(uint8_t cmd) {
    uint8_t buffer[2] = { OLED_COMMAND, cmd };
    while (!oled_tx_done);
    oled_tx_done = 0;
    HAL_I2C_Master_Transmit_IT(oled_i2c, OLED_ADDRESS, buffer, 2);
    while (!oled_tx_done);
}

static void OLED_WriteData(uint8_t data) {
    uint8_t buffer[2] = { OLED_DATA, data };
    while (!oled_tx_done);
    oled_tx_done = 0;
    HAL_I2C_Master_Transmit_IT(oled_i2c, OLED_ADDRESS, buffer, 2);
    while (!oled_tx_done);
}

static void OLED_SetPosition(uint8_t page, uint8_t column) {
	OLED_WriteCommand(0xB0 + page);
	OLED_WriteCommand(0x00 + (column & 0x0F));
	OLED_WriteCommand(0x10 + ((column >> 4) & 0x0F));
}

void OLED_Init(I2C_HandleTypeDef *hi2c) {
	oled_i2c = hi2c;
	HAL_Delay(100);
	OLED_WriteCommand(0xAE);
	OLED_WriteCommand(0xD5);
	OLED_WriteCommand(0x80);
	OLED_WriteCommand(0xA8);
	OLED_WriteCommand(0x3F);
	OLED_WriteCommand(0xD3);
	OLED_WriteCommand(0x00);
	OLED_WriteCommand(0x40);
	OLED_WriteCommand(0x8D);
	OLED_WriteCommand(0x14);
	OLED_WriteCommand(0x20);
	OLED_WriteCommand(0x00);
	OLED_WriteCommand(0xA1);
	OLED_WriteCommand(0xC8);
	OLED_WriteCommand(0xDA);
	OLED_WriteCommand(0x12);
	OLED_WriteCommand(0x81);
	OLED_WriteCommand(0xCF);
	OLED_WriteCommand(0xD9);
	OLED_WriteCommand(0xF1);
	OLED_WriteCommand(0xDB);
	OLED_WriteCommand(0x40);
	OLED_WriteCommand(0xA4);
	OLED_WriteCommand(0xA6);
	OLED_WriteCommand(0xAF);
}

void OLED_FillScreen(uint8_t pattern) {
	for (uint8_t page = 0; page < 8; page++) {
		OLED_SetPosition(page, 2);
		for (uint8_t col = 0; col < 128; col++) {
			OLED_WriteData(pattern);
		}
	}
}

void OLED_DrawChar(uint8_t x, uint8_t page, char c) {
	const uint8_t *bitmap = get_char_bitmap(c);
	OLED_SetPosition(page, x + 2);
	for (int i = 0; i < 5; i++)
		OLED_WriteData(bitmap[i]);
	OLED_WriteData(0x00);
}

void OLED_DrawString(uint8_t x, uint8_t page, const char *str) {
	while (*str) {
		OLED_DrawChar(x, page, *str++);
		x += 6;
	}
}

void OLED_DrawMidiMessage(uint8_t note, uint8_t velocity) {
	char aux[32];
    char midiString[8];

	OLED_FillScreen(0x00);

	MIDI_MidiNoteToString(note, midiString);
	sprintf(aux, "Note: %s (%d)", midiString, note);
	OLED_DrawString(0, 0, aux);
	sprintf(aux, "Velocity: %d", velocity);
	OLED_DrawString(0, 1, aux);
}

void HAL_I2C_MasterTxCpltCallback(I2C_HandleTypeDef *hi2c) {
    if (hi2c == oled_i2c) {
        oled_tx_done = 1;
    }
}

void HAL_I2C_ErrorCallback(I2C_HandleTypeDef *hi2c) {
    if (hi2c == oled_i2c) {
        oled_tx_done = 1;
    }
}
